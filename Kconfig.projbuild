## Kconfig.projbuild
```kconfig
menu "MyFi Configuration"

    config MYFI_SSID
        string "SSID"
        default "myssid"
        help
            SSID (network name) to connect to.

    config MYFI_PASSWORD
        string "SSID Password"
        default "password"
        help
            SSID password (WPA or WPA2).

    config MYFI_RETRY_MAX
        int "Maximum number of retry attempts"
        default 5
        help
            Maximum number of times to attempt to connect.

    config MYFI_USE_STATIC_IP
        bool "Set static IP Address"
        default n
        help
            Check to use a static IP address.

    config MYFI_IP
        string "Static IP"
        default "192.168.0.100"
        help
            Static IP address.
        depends on MYFI_USE_STATIC_IP

    config MYFI_GATEWAY
        string "Gateway"
        default "192.168.0.1"
        help
            Gateway IP address.
        depends on MYFI_USE_STATIC_IP

    config MYFI_NETMASK
        string "Netmask"
        default "255.255.255.0"
        help
            Network netmask.
        depends on MYFI_USE_STATIC_IP

    config MYFI_DNS_PRIMARY
        string "Primary DNS Server"
        default "0.0.0.0"
        help
            Primary DNS server.
        depends on MYFI_USE_STATIC_IP

    config MYFI_DNS_SECONDARY
        string "Secondary DNS Server"
        default "0.0.0.0"
        help
            Secondary DNS server.
        depends on MYFI_USE_STATIC_IP

endmenu
```
